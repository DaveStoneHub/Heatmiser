## components/board/Kconfig
```kconfig
menu "Waveshare 7 inch display"

    config BOARD_LCD_PCLK_MHZ
        int "RGB pixel clock (MHz)"
        range 10 24
        default 16
        help
            Waveshare's demo runs the panel at 16 MHz, about 40 frames a
            second. A higher clock draws more PSRAM bandwidth and makes drift
            more likely when Wi-Fi and flash are busy.

    config BOARD_LCD_BOUNCE_LINES
        int "Bounce buffer height (lines)"
        range 4 48
        default 10
        help
            Two internal-RAM bounce buffers of this many lines feed the panel,
            so it keeps streaming while PSRAM is busy. 480 must divide evenly
            by this. 10 lines is 2 x 16 KB.

    config BOARD_LVGL_TASK_PRIORITY
        int "LVGL task priority"
        default 4

    config BOARD_LVGL_TASK_STACK
        int "LVGL task stack (bytes)"
        default 8192

endmenu
```

## components/hm_bus/Kconfig
```kconfig
menu "Heatmiser RS485 bus"

    config HM_BUS_UART_NUM
        int "UART port"
        range 1 2
        default 1
        help
            UART used for the RS485 bus. The Waveshare ESP32-S3-Touch-LCD-7
            wires its onboard transceiver to UART1 on GPIO15/16.

    config HM_BUS_TX_GPIO
        int "TX GPIO (to transceiver DI)"
        default 15

    config HM_BUS_RX_GPIO
        int "RX GPIO (from transceiver RO)"
        default 16

    config HM_BUS_BAUD
        int "Baud rate"
        default 4800
        help
            Heatmiser V3 RS485 is fixed at 4800 8N1.

    config HM_BUS_MASTER_ADDR
        int "Master (bridge) address"
        range 129 160
        default 129
        help
            0x81 (129) to 0xA0 (160). 0x81 is what the MCV3 and TFT use.

    config HM_BUS_DEFAULT_STAT
        int "Default thermostat address for bench commands"
        range 1 32
        default 1

    config HM_BUS_REPLY_TIMEOUT_MS
        int "Reply timeout (ms) from end of request to first reply byte"
        default 1000

    config HM_BUS_INTERBYTE_TIMEOUT_MS
        int "Inter-byte silence (ms) that ends a frame early"
        default 50

    config HM_BUS_GAP_MS
        int "Idle bus gap (ms) after each transaction"
        default 100
        help
            The V3 document asks for at least 100 ms after a reply before the
            next frame.

    config HM_BUS_EDGE_TIMING
        bool "Timestamp the reply start bit with a GPIO interrupt on RX"
        default y
        help
            Gives turnaround to a few microseconds instead of the UART
            driver's millisecond granularity. Turn off if it ever interferes
            with reception.

endmenu
```

## components/hm_poller/Kconfig
```kconfig
menu "Heatmiser poller"

    config HM_POLL_INTERVAL_MS
        int "Poll interval (ms): each stat's full DCB is read once per interval"
        range 5000 60000
        default 10000

    config HM_POLL_WRITE_TIMEOUT_MS
        int "Write ack timeout (ms)"
        default 1000
        help
            The V3 document asks for 1000 ms. The bench measured read
            turnaround at about 7 ms; keep the spec value for writes until
            write turnaround has been measured too.

    config HM_POLL_WRITE_RETRIES
        int "Write retries after the first attempt"
        range 0 5
        default 5

    config HM_POLL_OFFLINE_AFTER
        int "Missed polls in a row before a stat is offline"
        range 1 10
        default 3

    config HM_POLL_OFFLINE_RETRY_MS
        int "Retry interval for an offline stat (ms)"
        default 60000

    config HM_POLL_SCAN_TIMEOUT_MS
        int "Scan first-pass timeout (ms)"
        range 20 1000
        default 100
        help
            Turnaround measured on the bench was 7 ms (max 9.5 ms), so 100 ms
            leaves a wide margin and keeps an empty-bus scan to a few seconds.

    config HM_POLL_SCAN_RECHECK_MS
        int "Scan second-pass timeout for the misses (ms, 0 = no second pass)"
        range 0 2000
        default 300

    config HM_POLL_TASK_PRIORITY
        int "Poller task priority"
        default 10

endmenu
```

## components/ota/Kconfig
```kconfig
menu "Heatmiser firmware updates"

    config HM_OTA_REPO
        string "GitHub repository with the releases"
        default "davestonehub/heatmiser"
        help
            The bridge looks for the latest release of this repository
            (owner/name). It must be public: the bridge has no token.

    config HM_OTA_ASSET
        string "Firmware file attached to each release"
        default "heatmiser_bridge.bin"

    config HM_OTA_VERIFY_S
        int "Seconds a new firmware must run healthy before it is kept"
        range 30 600
        default 90

    config HM_OTA_ROLLBACK_S
        int "Seconds after which an unhealthy new firmware is rolled back"
        range 120 1800
        default 300

endmenu
```

## tools/matter_probe/sdkconfig.defaults
```kconfig
CONFIG_IDF_TARGET="esp32s3"
CONFIG_ESPTOOLPY_FLASHSIZE_16MB=y
CONFIG_PARTITION_TABLE_CUSTOM=y
CONFIG_PARTITION_TABLE_CUSTOM_FILENAME="../../partitions.csv"
CONFIG_SPIRAM=y
CONFIG_SPIRAM_MODE_OCT=y
CONFIG_BT_ENABLED=y
CONFIG_BT_NIMBLE_ENABLED=y
CONFIG_BT_NIMBLE_EXT_ADV=n
CONFIG_USE_BLE_ONLY_FOR_COMMISSIONING=y
CONFIG_LWIP_IPV6_AUTOCONFIG=y
CONFIG_MBEDTLS_HKDF_C=y
CONFIG_ESP_MATTER_MAX_DYNAMIC_ENDPOINT_COUNT=34
```
